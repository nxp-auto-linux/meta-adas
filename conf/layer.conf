## conf/layer.conf
```bitbake
# We have a conf directory, add to BBPATH
BBPATH .= ":${LAYERDIR}"

# We have recipes-* directories, add to BBFILES
BBFILES += "${LAYERDIR}/recipes-*/*/*.bb \
            ${LAYERDIR}/recipes-*/*/*.bbappend \
            ${LAYERDIR}/recipes-*/*/*/*.bb \
            ${LAYERDIR}/recipes-*/*/*/*.bbappend \
            ${LAYERDIR}/packagegroups/*.bb"

BBFILE_COLLECTIONS += "meta-adas"
BBFILE_PATTERN_meta-adas = "^${LAYERDIR}/"
BBFILE_PRIORITY_meta-adas = "5"

LAYERVERSION_meta-adas = "1"
PREFERRED_VERSION_boost ?= "1.62%"
PREFERRED_VERSION_boost-native ?= "1.62%"
PREFERRED_VERSION_nativesdk-boost ?= "1.62%"
PREFERRED_VERSION_fftw ?= "3.3.4"
PREFERRED_VERSION_ffmpeg ?= "2.8.5"
M0_TOOLCHAIN_DIR ?= "${TOPDIR}/tmp/m0-toolchain"
VSDK_OUTPUT_DIR_NAME ?= "/vsdk/demos"
```
